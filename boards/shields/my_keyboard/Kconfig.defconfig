## boards/shields/my_keyboard/Kconfig.defconfig
```kconfig
if SHIELD_MY_KEYBOARD_LEFT || SHIELD_MY_KEYBOARD_RIGHT

config ZMK_KEYBOARD_NAME
    default "My Keyboard"

config ZMK_SPLIT
    default y

config ZMK_SPLIT_BLE_ROLE_CENTRAL
    default y if SHIELD_MY_KEYBOARD_LEFT

endif
```

## config/west.yml
```yaml
manifest:
  remotes:
    - name: zmkfirmware
      url-base: https://github.com/zmkfirmware
  projects:
    - name: zmk
      remote: zmkfirmware
      revision: 6765b2f4bfef28d4e6566a5cbef39eb25b98ca36
      import: app/west.yml
  self:
    path: config
```
